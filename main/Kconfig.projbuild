## main/Kconfig.projbuild
```kconfig
menu "Dashboard Configuration"

config GH_USERNAME
    string "GitHub username (compile-time fallback)"
    default ""
    help
        Optional. Normally set at runtime via the first-boot provisioning
        portal and stored in NVS. Only used if NVS is empty.

config GH_TOKEN
    string "GitHub personal access token (compile-time fallback)"
    default ""
    help
        Optional. Normally set at runtime via the first-boot provisioning
        portal and stored in NVS. Only used if NVS is empty.
        Needs repo scope. Traffic API requires auth.

config DASHBOARD_CYCLE_SEC
    int "Screen cycle interval (seconds)"
    default 30
    range 5 300

config DASHBOARD_TIMEZONE
    string "Timezone (POSIX TZ string)"
    default "CST6CDT,M3.2.0,M11.1.0"
    help
        POSIX TZ string for local time. Examples:
          CST6CDT,M3.2.0,M11.1.0   US Central (handles DST)
          EST5EDT,M3.2.0,M11.1.0   US Eastern
          MST7MDT,M3.2.0,M11.1.0   US Mountain
          PST8PDT,M3.2.0,M11.1.0   US Pacific
          UTC0                      UTC

config DASHBOARD_REFRESH_HOUR
    int "Daily refresh hour (local time, 0-23)"
    default 6
    range 0 23
    help
        Hour of day in local time at which stats are re-fetched from GitHub.
        GitHub traffic data typically updates around midnight UTC.

endmenu
```

## sdkconfig.defaults
```kconfig
# Target: ESP32-P4
CONFIG_IDF_TARGET="esp32p4"

# Flash
CONFIG_ESPTOOLPY_FLASHSIZE_16MB=y

# CPU (360 MHz)
CONFIG_ESP_DEFAULT_CPU_FREQ_360=y
CONFIG_FREERTOS_HZ=1000

# Console — Waveshare board: UART primary, USB JTAG secondary, ROM port 0
# (EV board uses USB_SERIAL_JTAG primary + ROM port 6 — that config gives no app logs here)
CONFIG_ESP_CONSOLE_UART_DEFAULT=y
CONFIG_ESP_CONSOLE_SECONDARY_USB_SERIAL_JTAG=y
CONFIG_ESP_CONSOLE_ROM_SERIAL_PORT_NUM=0

# Main task stack
CONFIG_ESP_MAIN_TASK_STACK_SIZE=16384

# Custom partition table (4 MB app partition)
CONFIG_PARTITION_TABLE_CUSTOM=y
CONFIG_PARTITION_TABLE_CUSTOM_FILENAME="partitions.csv"

# PSRAM (HEX @ 200 MHz)
CONFIG_IDF_EXPERIMENTAL_FEATURES=y
CONFIG_SPIRAM=y
CONFIG_SPIRAM_MODE_HEX=y
CONFIG_SPIRAM_SPEED_200M=y
CONFIG_SPIRAM_USE_MALLOC=y
CONFIG_SPIRAM_MEMTEST=y
CONFIG_SPIRAM_MALLOC_ALWAYSINTERNAL=16384
CONFIG_SPIRAM_MALLOC_RESERVE_INTERNAL=32768

# esp_hosted: ESP32-C6 co-processor via SDIO for WiFi
CONFIG_ESP_HOSTED_ENABLED=y
CONFIG_ESP_HOSTED_SDIO_HOST_INTERFACE=y
CONFIG_ESP_HOSTED_IDF_SLAVE_TARGET="esp32c6"
CONFIG_ESP_HOSTED_SDIO_RESET_ACTIVE_HIGH=y
CONFIG_ESP_HOSTED_SDIO_GPIO_RESET_SLAVE=54
CONFIG_ESP_HOSTED_GPIO_SLAVE_RESET_SLAVE=54
CONFIG_ESP_HOSTED_SDIO_4_BIT_BUS=y
CONFIG_ESP_HOSTED_SDIO_BUS_WIDTH=4
CONFIG_ESP_HOSTED_SDIO_CLOCK_FREQ_KHZ=40000
CONFIG_ESP_HOSTED_SDIO_PIN_CMD=19
CONFIG_ESP_HOSTED_SDIO_PIN_CLK=18
CONFIG_ESP_HOSTED_SDIO_PIN_D0=14
CONFIG_ESP_HOSTED_SDIO_PIN_D1=15
CONFIG_ESP_HOSTED_SDIO_PIN_D2=16
CONFIG_ESP_HOSTED_SDIO_PIN_D3=17
CONFIG_ESP_WIFI_REMOTE_ENABLED=y

# Disable SoftAP
CONFIG_ESP_WIFI_SOFTAP_SUPPORT=n

# HTTPS (for GitHub API)
CONFIG_MBEDTLS_CERTIFICATE_BUNDLE=y
CONFIG_MBEDTLS_CERTIFICATE_BUNDLE_DEFAULT_FULL=y
```
